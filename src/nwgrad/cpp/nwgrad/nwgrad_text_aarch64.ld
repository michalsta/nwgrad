/* Code layout for GNU ld (ELF), passed with -Wl,-T: see "Code placement" in CMakeLists.txt and AGENTS.md.
   GENERATED by tools/gen_text_ld.py (units-aarch64) -- edit that, not this.  INSERT augments the default script.

   Why: on Alder Lake (nighthaven) a kernel's speed depends on its address mod 4 KiB relative to the
   engine code that drives it: moving the bindings 448 bytes against the kernels made float32 inter-pair
   cells up to 1.13x slower, with identical code.  With the default script each function's address was
   the size of everything linked before it, so a change anywhere moved every kernel after it.  Here
   each block below starts at a fixed offset within a page, so its code keeps its address mod 4096
   whatever the other blocks do.
   Cost: at most 4 KiB of padding per block.  The experiment knob's pads (placement_shift.cpp) go first
   and at the start of the bindings. */
SECTIONS
{
  .text.nwgrad ALIGN(4096) :
  {
    KEEP(*(.text.unlikely.nwgrad_placement_shift))
    . = ALIGN(4096); KEEP(*(.text.nwgrad_placement_shift)) *py_exports.cpp.o(.text._Z* .text.Py*)
    . = ALIGN(4096); *level_neon.cpp.o(.text._Z*)
    . = ALIGN(4096); *level_neon_soft.cpp.o(.text._Z*)
    . = ALIGN(4096); *level_neon_inter.cpp.o(.text._Z*)
    . = ALIGN(4096);
  }
}
INSERT BEFORE .text;
