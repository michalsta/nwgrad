/* Code layout for GNU ld (ELF), passed with -Wl,-T: see "Code placement" in CMakeLists.txt and AGENTS.md.
   GENERATED by tools/gen_text_ld.py (groups) -- edit that, not this.  INSERT augments the default script.

   Why: on Alder Lake (nighthaven) a kernel's speed depends on its address mod 4 KiB relative to the
   engine code that drives it: moving the bindings 448 bytes against the kernels made float32 inter-pair
   cells up to 1.13x slower, with identical code.  With the default script each function's address was
   the size of everything linked before it, so a change anywhere moved every kernel after it.  Here
   each block below starts at a fixed offset within a page, so its code keeps its address mod 4096
   whatever the other blocks do.
   Cost: at most 4 KiB of padding per block.  The experiment knob's pads (placement_shift.cpp) go first
   and at the start of the bindings / of the avx2 inter-pair float32 group. */
SECTIONS
{
  .text.nwgrad ALIGN(4096) :
  {
    KEEP(*(.text.unlikely.nwgrad_placement_shift))
    . = ALIGN(4096); *py_exports.cpp.o(.text._Z*BatchEngineIfL8GapModel0EL9AlignMode0E* .text._Z*AlignerIL8GapModel0EL9AlignMode0EL9AlignBand?EfE*)
    . = ALIGN(4096); *py_exports.cpp.o(.text._Z*BatchEngineIfL8GapModel0EL9AlignMode1E* .text._Z*AlignerIL8GapModel0EL9AlignMode1EL9AlignBand?EfE*)
    . = ALIGN(4096); *py_exports.cpp.o(.text._Z*BatchEngineIfL8GapModel0EL9AlignMode2E* .text._Z*AlignerIL8GapModel0EL9AlignMode2EL9AlignBand?EfE*)
    . = ALIGN(4096); *py_exports.cpp.o(.text._Z*BatchEngineIfL8GapModel1EL9AlignMode0E* .text._Z*AlignerIL8GapModel1EL9AlignMode0EL9AlignBand?EfE*)
    . = ALIGN(4096); *py_exports.cpp.o(.text._Z*BatchEngineIfL8GapModel1EL9AlignMode1E* .text._Z*AlignerIL8GapModel1EL9AlignMode1EL9AlignBand?EfE*)
    . = ALIGN(4096); *py_exports.cpp.o(.text._Z*BatchEngineIfL8GapModel1EL9AlignMode2E* .text._Z*AlignerIL8GapModel1EL9AlignMode2EL9AlignBand?EfE*)
    . = ALIGN(4096); *py_exports.cpp.o(.text._Z*BatchEngineIdL8GapModel0EL9AlignMode0E* .text._Z*AlignerIL8GapModel0EL9AlignMode0EL9AlignBand?EdE*)
    . = ALIGN(4096); *py_exports.cpp.o(.text._Z*BatchEngineIdL8GapModel0EL9AlignMode1E* .text._Z*AlignerIL8GapModel0EL9AlignMode1EL9AlignBand?EdE*)
    . = ALIGN(4096); *py_exports.cpp.o(.text._Z*BatchEngineIdL8GapModel0EL9AlignMode2E* .text._Z*AlignerIL8GapModel0EL9AlignMode2EL9AlignBand?EdE*)
    . = ALIGN(4096); *py_exports.cpp.o(.text._Z*BatchEngineIdL8GapModel1EL9AlignMode0E* .text._Z*AlignerIL8GapModel1EL9AlignMode0EL9AlignBand?EdE*)
    . = ALIGN(4096); *py_exports.cpp.o(.text._Z*BatchEngineIdL8GapModel1EL9AlignMode1E* .text._Z*AlignerIL8GapModel1EL9AlignMode1EL9AlignBand?EdE*)
    . = ALIGN(4096); *py_exports.cpp.o(.text._Z*BatchEngineIdL8GapModel1EL9AlignMode2E* .text._Z*AlignerIL8GapModel1EL9AlignMode2EL9AlignBand?EdE*)
    . = ALIGN(4096); *py_exports.cpp.o(.text._Z*BatchEngineIsL8GapModel0EL9AlignMode0E* .text._Z*AlignerIL8GapModel0EL9AlignMode0EL9AlignBand?EsE*)
    . = ALIGN(4096); *py_exports.cpp.o(.text._Z*BatchEngineIsL8GapModel0EL9AlignMode1E* .text._Z*AlignerIL8GapModel0EL9AlignMode1EL9AlignBand?EsE*)
    . = ALIGN(4096); *py_exports.cpp.o(.text._Z*BatchEngineIsL8GapModel0EL9AlignMode2E* .text._Z*AlignerIL8GapModel0EL9AlignMode2EL9AlignBand?EsE*)
    . = ALIGN(4096); *py_exports.cpp.o(.text._Z*BatchEngineIsL8GapModel1EL9AlignMode0E* .text._Z*AlignerIL8GapModel1EL9AlignMode0EL9AlignBand?EsE*)
    . = ALIGN(4096); *py_exports.cpp.o(.text._Z*BatchEngineIsL8GapModel1EL9AlignMode1E* .text._Z*AlignerIL8GapModel1EL9AlignMode1EL9AlignBand?EsE*)
    . = ALIGN(4096); *py_exports.cpp.o(.text._Z*BatchEngineIsL8GapModel1EL9AlignMode2E* .text._Z*AlignerIL8GapModel1EL9AlignMode2EL9AlignBand?EsE*)
    . = ALIGN(4096); *py_exports.cpp.o(.text._Z*BatchEngineIiL8GapModel0EL9AlignMode0E* .text._Z*AlignerIL8GapModel0EL9AlignMode0EL9AlignBand?EiE*)
    . = ALIGN(4096); *py_exports.cpp.o(.text._Z*BatchEngineIiL8GapModel0EL9AlignMode1E* .text._Z*AlignerIL8GapModel0EL9AlignMode1EL9AlignBand?EiE*)
    . = ALIGN(4096); *py_exports.cpp.o(.text._Z*BatchEngineIiL8GapModel0EL9AlignMode2E* .text._Z*AlignerIL8GapModel0EL9AlignMode2EL9AlignBand?EiE*)
    . = ALIGN(4096); *py_exports.cpp.o(.text._Z*BatchEngineIiL8GapModel1EL9AlignMode0E* .text._Z*AlignerIL8GapModel1EL9AlignMode0EL9AlignBand?EiE*)
    . = ALIGN(4096); *py_exports.cpp.o(.text._Z*BatchEngineIiL8GapModel1EL9AlignMode1E* .text._Z*AlignerIL8GapModel1EL9AlignMode1EL9AlignBand?EiE*)
    . = ALIGN(4096); *py_exports.cpp.o(.text._Z*BatchEngineIiL8GapModel1EL9AlignMode2E* .text._Z*AlignerIL8GapModel1EL9AlignMode2EL9AlignBand?EiE*)
    . = ALIGN(4096); *py_exports.cpp.o(.text._Z*BatchEngineIlL8GapModel0EL9AlignMode0E* .text._Z*AlignerIL8GapModel0EL9AlignMode0EL9AlignBand?ElE*)
    . = ALIGN(4096); *py_exports.cpp.o(.text._Z*BatchEngineIlL8GapModel0EL9AlignMode1E* .text._Z*AlignerIL8GapModel0EL9AlignMode1EL9AlignBand?ElE*)
    . = ALIGN(4096); *py_exports.cpp.o(.text._Z*BatchEngineIlL8GapModel0EL9AlignMode2E* .text._Z*AlignerIL8GapModel0EL9AlignMode2EL9AlignBand?ElE*)
    . = ALIGN(4096); *py_exports.cpp.o(.text._Z*BatchEngineIlL8GapModel1EL9AlignMode0E* .text._Z*AlignerIL8GapModel1EL9AlignMode0EL9AlignBand?ElE*)
    . = ALIGN(4096); *py_exports.cpp.o(.text._Z*BatchEngineIlL8GapModel1EL9AlignMode1E* .text._Z*AlignerIL8GapModel1EL9AlignMode1EL9AlignBand?ElE*)
    . = ALIGN(4096); *py_exports.cpp.o(.text._Z*BatchEngineIlL8GapModel1EL9AlignMode2E* .text._Z*AlignerIL8GapModel1EL9AlignMode2EL9AlignBand?ElE*)
    . = ALIGN(4096); *py_exports.cpp.o(.text._ZNSt* .text._ZNKSt* .text._ZSt* .text._ZN9__gnu_cxx*)
    . = ALIGN(4096); KEEP(*(.text.nwgrad_placement_shift)) *py_exports.cpp.o(.text._Z* .text.Py*)
    . = ALIGN(4096); . += 3712; KEEP(*(.text.nwgrad_placement_shift_grp)) *level_avx2_inter.cpp.o(.text._Z*[a-z_]If[LE]*)
    . = ALIGN(4096); *level_avx2_inter.cpp.o(.text._Z*[a-z_]Id[LE]*)
    . = ALIGN(4096); *level_avx2_inter.cpp.o(.text._Z*[a-z_]Is[LE]*)
    . = ALIGN(4096); *level_avx2_inter.cpp.o(.text._Z*[a-z_]Ii[LE]*)
    . = ALIGN(4096); *level_avx2_inter.cpp.o(.text._Z*[a-z_]Il[LE]*)
    . = ALIGN(4096); *level_avx2_inter.cpp.o(.text._Z*)
    . = ALIGN(4096); *level_avx2.cpp.o(.text._Z*[a-z_]If[LE]*)
    . = ALIGN(4096); *level_avx2.cpp.o(.text._Z*[a-z_]Id[LE]*)
    . = ALIGN(4096); *level_avx2.cpp.o(.text._Z*[a-z_]Is[LE]*)
    . = ALIGN(4096); *level_avx2.cpp.o(.text._Z*[a-z_]Ii[LE]*)
    . = ALIGN(4096); *level_avx2.cpp.o(.text._Z*[a-z_]Il[LE]*)
    . = ALIGN(4096); *level_avx2.cpp.o(.text._Z*)
    . = ALIGN(4096); *level_avx2_soft.cpp.o(.text._Z*[a-z_]If[LE]*)
    . = ALIGN(4096); *level_avx2_soft.cpp.o(.text._Z*[a-z_]Id[LE]*)
    . = ALIGN(4096); *level_avx2_soft.cpp.o(.text._Z*[a-z_]Is[LE]*)
    . = ALIGN(4096); *level_avx2_soft.cpp.o(.text._Z*[a-z_]Ii[LE]*)
    . = ALIGN(4096); *level_avx2_soft.cpp.o(.text._Z*[a-z_]Il[LE]*)
    . = ALIGN(4096); *level_avx2_soft.cpp.o(.text._Z*)
    . = ALIGN(4096); *level_avx512_inter.cpp.o(.text._Z*[a-z_]If[LE]*)
    . = ALIGN(4096); *level_avx512_inter.cpp.o(.text._Z*[a-z_]Id[LE]*)
    . = ALIGN(4096); *level_avx512_inter.cpp.o(.text._Z*[a-z_]Is[LE]*)
    . = ALIGN(4096); *level_avx512_inter.cpp.o(.text._Z*[a-z_]Ii[LE]*)
    . = ALIGN(4096); *level_avx512_inter.cpp.o(.text._Z*[a-z_]Il[LE]*)
    . = ALIGN(4096); *level_avx512_inter.cpp.o(.text._Z*)
    . = ALIGN(4096); *level_avx512.cpp.o(.text._Z*[a-z_]If[LE]*)
    . = ALIGN(4096); *level_avx512.cpp.o(.text._Z*[a-z_]Id[LE]*)
    . = ALIGN(4096); *level_avx512.cpp.o(.text._Z*[a-z_]Is[LE]*)
    . = ALIGN(4096); *level_avx512.cpp.o(.text._Z*[a-z_]Ii[LE]*)
    . = ALIGN(4096); *level_avx512.cpp.o(.text._Z*[a-z_]Il[LE]*)
    . = ALIGN(4096); *level_avx512.cpp.o(.text._Z*)
    . = ALIGN(4096); *level_avx512_soft.cpp.o(.text._Z*[a-z_]If[LE]*)
    . = ALIGN(4096); *level_avx512_soft.cpp.o(.text._Z*[a-z_]Id[LE]*)
    . = ALIGN(4096); *level_avx512_soft.cpp.o(.text._Z*[a-z_]Is[LE]*)
    . = ALIGN(4096); *level_avx512_soft.cpp.o(.text._Z*[a-z_]Ii[LE]*)
    . = ALIGN(4096); *level_avx512_soft.cpp.o(.text._Z*[a-z_]Il[LE]*)
    . = ALIGN(4096); *level_avx512_soft.cpp.o(.text._Z*)
    . = ALIGN(4096); *level_sse4_inter.cpp.o(.text._Z*[a-z_]If[LE]*)
    . = ALIGN(4096); *level_sse4_inter.cpp.o(.text._Z*[a-z_]Id[LE]*)
    . = ALIGN(4096); *level_sse4_inter.cpp.o(.text._Z*[a-z_]Is[LE]*)
    . = ALIGN(4096); *level_sse4_inter.cpp.o(.text._Z*[a-z_]Ii[LE]*)
    . = ALIGN(4096); *level_sse4_inter.cpp.o(.text._Z*[a-z_]Il[LE]*)
    . = ALIGN(4096); *level_sse4_inter.cpp.o(.text._Z*)
    . = ALIGN(4096); *level_sse4.cpp.o(.text._Z*[a-z_]If[LE]*)
    . = ALIGN(4096); *level_sse4.cpp.o(.text._Z*[a-z_]Id[LE]*)
    . = ALIGN(4096); *level_sse4.cpp.o(.text._Z*[a-z_]Is[LE]*)
    . = ALIGN(4096); *level_sse4.cpp.o(.text._Z*[a-z_]Ii[LE]*)
    . = ALIGN(4096); *level_sse4.cpp.o(.text._Z*[a-z_]Il[LE]*)
    . = ALIGN(4096); *level_sse4.cpp.o(.text._Z*)
    . = ALIGN(4096); *level_sse4_soft.cpp.o(.text._Z*[a-z_]If[LE]*)
    . = ALIGN(4096); *level_sse4_soft.cpp.o(.text._Z*[a-z_]Id[LE]*)
    . = ALIGN(4096); *level_sse4_soft.cpp.o(.text._Z*[a-z_]Is[LE]*)
    . = ALIGN(4096); *level_sse4_soft.cpp.o(.text._Z*[a-z_]Ii[LE]*)
    . = ALIGN(4096); *level_sse4_soft.cpp.o(.text._Z*[a-z_]Il[LE]*)
    . = ALIGN(4096); *level_sse4_soft.cpp.o(.text._Z*)
    . = ALIGN(4096); *level_baseline_inter.cpp.o(.text._Z*[a-z_]If[LE]*)
    . = ALIGN(4096); *level_baseline_inter.cpp.o(.text._Z*[a-z_]Id[LE]*)
    . = ALIGN(4096); *level_baseline_inter.cpp.o(.text._Z*[a-z_]Is[LE]*)
    . = ALIGN(4096); *level_baseline_inter.cpp.o(.text._Z*[a-z_]Ii[LE]*)
    . = ALIGN(4096); *level_baseline_inter.cpp.o(.text._Z*[a-z_]Il[LE]*)
    . = ALIGN(4096); *level_baseline_inter.cpp.o(.text._Z*)
    . = ALIGN(4096); *level_baseline.cpp.o(.text._Z*[a-z_]If[LE]*)
    . = ALIGN(4096); *level_baseline.cpp.o(.text._Z*[a-z_]Id[LE]*)
    . = ALIGN(4096); *level_baseline.cpp.o(.text._Z*[a-z_]Is[LE]*)
    . = ALIGN(4096); *level_baseline.cpp.o(.text._Z*[a-z_]Ii[LE]*)
    . = ALIGN(4096); *level_baseline.cpp.o(.text._Z*[a-z_]Il[LE]*)
    . = ALIGN(4096); *level_baseline.cpp.o(.text._Z*)
    . = ALIGN(4096); *level_baseline_soft.cpp.o(.text._Z*[a-z_]If[LE]*)
    . = ALIGN(4096); *level_baseline_soft.cpp.o(.text._Z*[a-z_]Id[LE]*)
    . = ALIGN(4096); *level_baseline_soft.cpp.o(.text._Z*[a-z_]Is[LE]*)
    . = ALIGN(4096); *level_baseline_soft.cpp.o(.text._Z*[a-z_]Ii[LE]*)
    . = ALIGN(4096); *level_baseline_soft.cpp.o(.text._Z*[a-z_]Il[LE]*)
    . = ALIGN(4096); *level_baseline_soft.cpp.o(.text._Z*)
    . = ALIGN(4096); *level_neon_inter.cpp.o(.text._Z*[a-z_]If[LE]*)
    . = ALIGN(4096); *level_neon_inter.cpp.o(.text._Z*[a-z_]Id[LE]*)
    . = ALIGN(4096); *level_neon_inter.cpp.o(.text._Z*[a-z_]Is[LE]*)
    . = ALIGN(4096); *level_neon_inter.cpp.o(.text._Z*[a-z_]Ii[LE]*)
    . = ALIGN(4096); *level_neon_inter.cpp.o(.text._Z*[a-z_]Il[LE]*)
    . = ALIGN(4096); *level_neon_inter.cpp.o(.text._Z*)
    . = ALIGN(4096); *level_neon.cpp.o(.text._Z*[a-z_]If[LE]*)
    . = ALIGN(4096); *level_neon.cpp.o(.text._Z*[a-z_]Id[LE]*)
    . = ALIGN(4096); *level_neon.cpp.o(.text._Z*[a-z_]Is[LE]*)
    . = ALIGN(4096); *level_neon.cpp.o(.text._Z*[a-z_]Ii[LE]*)
    . = ALIGN(4096); *level_neon.cpp.o(.text._Z*[a-z_]Il[LE]*)
    . = ALIGN(4096); *level_neon.cpp.o(.text._Z*)
    . = ALIGN(4096); *level_neon_soft.cpp.o(.text._Z*[a-z_]If[LE]*)
    . = ALIGN(4096); *level_neon_soft.cpp.o(.text._Z*[a-z_]Id[LE]*)
    . = ALIGN(4096); *level_neon_soft.cpp.o(.text._Z*[a-z_]Is[LE]*)
    . = ALIGN(4096); *level_neon_soft.cpp.o(.text._Z*[a-z_]Ii[LE]*)
    . = ALIGN(4096); *level_neon_soft.cpp.o(.text._Z*[a-z_]Il[LE]*)
    . = ALIGN(4096); *level_neon_soft.cpp.o(.text._Z*)
    . = ALIGN(4096);
  }
}
INSERT BEFORE .text;
